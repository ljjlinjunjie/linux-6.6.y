## drivers/net/wireless/realtek/rtl8188gu/Kconfig
```kconfig
config RTL8188GU
	tristate "Realtek 8188GU USB WiFi"
	depends on USB
	default m
	help
	  Help message of RTL8188GU
```

## drivers/net/wireless/realtek/rtl8189fs/Kconfig
```kconfig
config RTL8189FS
	tristate "Realtek 8189F SDIO WiFi"
	depends on USB
	default m
	help
	  Help message of RTL8189FS
```
